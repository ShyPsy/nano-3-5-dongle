## config/west.yml
```yaml
manifest:
  remotes:
    - name: zmkfirmware
      url-base: https://github.com/zmkfirmware
    - name: badjeff
      url-base: https://github.com/badjeff
    - name: carrefinho                            # <--- add this
      url-base: https://github.com/carrefinho     # <--- and this
      
  projects:
    - name: zmk
      remote: zmkfirmware
      import: app/west.yml

    - name: zmk-pmw3610-driver
      remote: badjeff

    - name: prospector-zmk-module
      remote: carrefinho
      
  self:
    path: config
```
